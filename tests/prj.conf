## CMakeLists.txt
```
# SPDX-License-Identifier: Apache-2.0

cmake_minimum_required(VERSION 3.20.0)

# Make AkiraOS board and DTS roots available
list(APPEND BOARD_ROOT ${CMAKE_CURRENT_LIST_DIR}/..)
list(APPEND DTS_ROOT   ${CMAKE_CURRENT_LIST_DIR}/..)

find_package(Zephyr REQUIRED HINTS $ENV{ZEPHYR_BASE})
project(akiraos_tests)

# ── Include paths ──────────────────────────────────────────────────────────────
set(AKIRA_SRC ${CMAKE_CURRENT_LIST_DIR}/../src)
set(AKIRA_INC ${CMAKE_CURRENT_LIST_DIR}/../include)

target_include_directories(app PRIVATE
    ${AKIRA_SRC}
    ${AKIRA_SRC}/runtime
    ${AKIRA_SRC}/runtime/security
    ${AKIRA_SRC}/runtime/app_manager
    ${AKIRA_SRC}/connectivity
    ${AKIRA_SRC}/connectivity/ota
    ${AKIRA_INC}
    ${CMAKE_CURRENT_LIST_DIR}/../AkiraSDK/include
    ${CMAKE_CURRENT_LIST_DIR}/stubs
)

# ── Source files under test ────────────────────────────────────────────────────
target_sources(app PRIVATE
    # Sources under test
    ${AKIRA_SRC}/runtime/manifest_parser.c
    ${AKIRA_SRC}/runtime/security.c
    ${AKIRA_SRC}/runtime/security/app_signing_v2.c
    ${AKIRA_SRC}/runtime/security/sandbox.c
    ${AKIRA_SRC}/connectivity/ota/ota_manager.c
    ${AKIRA_SRC}/connectivity/ccsds/akira_cfdp_staging.c
    ${AKIRA_SRC}/connectivity/ccsds/akira_cfdp_service.c
    ${AKIRA_SRC}/connectivity/ccsds/ccsds_bch.c
    ${AKIRA_SRC}/connectivity/ccsds/ccsds_cltu.c
    ${AKIRA_SRC}/connectivity/ccsds/ccsds_crc16.c
    ${AKIRA_SRC}/connectivity/ccsds/ccsds_cfdp_checksum.c
    ${AKIRA_SRC}/connectivity/ccsds/ccsds_cfdp_entity.c
    ${AKIRA_SRC}/connectivity/ccsds/ccsds_cfdp_pdu.c
    ${AKIRA_SRC}/connectivity/ccsds/ccsds_cfdp_ranges.c
    ${AKIRA_SRC}/connectivity/ccsds/ccsds_cfdp_space_packet.c
    ${AKIRA_SRC}/connectivity/ccsds/ccsds_profile.c
    ${AKIRA_SRC}/connectivity/ccsds/ccsds_router.c
    ${AKIRA_SRC}/connectivity/ccsds/ccsds_rnd.c
    ${AKIRA_SRC}/connectivity/ccsds/ccsds_rs.c
    ${AKIRA_SRC}/connectivity/ccsds/ccsds_shell.c
    ${AKIRA_SRC}/connectivity/ccsds/ccsds_space_packet.c
    ${AKIRA_SRC}/connectivity/ccsds/ccsds_tc_frame.c
    ${AKIRA_SRC}/connectivity/ccsds/ccsds_tc_segment.c
    ${AKIRA_SRC}/connectivity/ccsds/ccsds_time_service.c
    ${AKIRA_SRC}/connectivity/ccsds/ccsds_tm_frame.c
    ${AKIRA_SRC}/connectivity/ccsds/ccsds_tm_udp_route.c

    # Stubs
    stubs/stub_mcuboot.c

    # Test suites
    src/test_manifest_parser.c
    src/test_security.c
    src/test_app_lifecycle.c
    src/test_ota_state.c
    src/test_ccsds_bch.c
    src/test_ccsds_cltu.c
    src/test_ccsds_crc16.c
    src/test_ccsds_cfdp_staging.c
    src/test_akira_cfdp_service.c
    src/test_ccsds_cfdp_checksum.c
    src/test_ccsds_cfdp_entity.c
    src/test_ccsds_cfdp_filestore.c
    src/test_ccsds_cfdp_pdu.c
    src/test_ccsds_cfdp_ranges.c
    src/test_ccsds_cfdp_space_packet.c
    src/test_ccsds_cfdp_types.c
    src/test_ccsds_cfdp_ut.c
    src/test_ccsds_profile.c
    src/test_ccsds_rnd.c
    src/test_ccsds_rs.c
    src/test_ccsds_shell.c
    src/test_ccsds_tc_frame.c
    src/test_ccsds_tc_segment.c
    src/test_ccsds_time_service.c
    src/test_ccsds_tm_frame.c
)

if(CONFIG_NETWORKING)
    target_sources(app PRIVATE
        ${AKIRA_SRC}/connectivity/ccsds/ccsds_tc_udp_input.c
    )
endif()

# ota_manager.c guards its flash_area and mcuboot includes behind:
#   #if defined(CONFIG_FLASH_MAP) && defined(CONFIG_BOOTLOADER_MCUBOOT)
# CONFIG_FLASH_MAP=y is set in prj.conf (flash simulator), but
# CONFIG_BOOTLOADER_MCUBOOT cannot be set via Kconfig on native_sim (it would
# select USE_DT_CODE_PARTITION which has unsatisfied SOC dependencies).
# Setting it as a per-file compile definition bypasses Kconfig entirely so
# ota_manager.c compiles with OTA_FLASH_AVAILABLE=1.  The boot_request_upgrade /
# boot_write_img_confirmed symbols are satisfied by stubs/stub_mcuboot.c.
set_source_files_properties(
    ${AKIRA_SRC}/connectivity/ota/ota_manager.c
    PROPERTIES COMPILE_DEFINITIONS "CONFIG_BOOTLOADER_MCUBOOT=1"
)
```

## Kconfig
```
# SPDX-License-Identifier: Apache-2.0
#
# Test-scope Kconfig for the AkiraOS ztest suite.
#
# rsource pulls in the parent AkiraOS/Kconfig (resolved relative to this
# file), which itself does `source "Kconfig.zephyr"` so all Zephyr and
# AkiraOS symbols are available.  Zephyr's kconfig.cmake auto-discovers
# this file via APPLICATION_SOURCE_DIR/Kconfig.

rsource "../Kconfig"
```

## prj.conf
```kconfig
# ── Zephyr test framework ──────────────────────────────────────────────────────
CONFIG_ZTEST=y
# CONFIG_ZTEST_NEW_API does not exist in Zephyr v4; new API is always on

# ── Coverage (gcov) ────────────────────────────────────────────────────────────
CONFIG_COVERAGE=y
CONFIG_COVERAGE_GCOV=y

# ── libc ───────────────────────────────────────────────────────────────────────
CONFIG_NEWLIB_LIBC=y
CONFIG_PICOLIBC=n
CONFIG_EXTERNAL_LIBC=n

# ── Logging ────────────────────────────────────────────────────────────────────
CONFIG_LOG=y
CONFIG_LOG_DEFAULT_LEVEL=2
CONFIG_SHELL=y

# ── Kernel / heap ──────────────────────────────────────────────────────────────
CONFIG_HEAP_MEM_POOL_SIZE=65536
CONFIG_MAIN_STACK_SIZE=4096

# ── AkiraOS config ─────────────────────────────────────────────────────────────
CONFIG_AKIRA_OS=y
CONFIG_AKIRA_LOG_LEVEL=2
CONFIG_AKIRA_WASM_RUNTIME=n
CONFIG_AKIRA_AUDIT_LOG_SIZE=16
CONFIG_AKIRA_SANDBOX_EXEC_TIMEOUT_MS=5000
CONFIG_AKIRA_APP_SIGNING=n
CONFIG_AKIRA_CCSDS=y
CONFIG_AKIRA_CCSDS_CFDP=y
CONFIG_AKIRA_CCSDS_SHELL=y
CONFIG_AKIRA_CCSDS_TM_MAX_SPACE_PACKET_LEN=4096
CONFIG_AKIRA_CCSDS_TM_QUEUE_DEPTH=4096
CONFIG_AKIRA_CCSDS_TM_FECF=y

# ── Crypto (for app_signing tests) ────────────────────────────────────────────
CONFIG_MBEDTLS=y
CONFIG_MBEDTLS_BUILTIN=y
CONFIG_MBEDTLS_SHA256=y
# Disable the smaller-footprint SHA-256 implementation — it produces wrong
# results on native_sim (at least with Zephyr v4.3.0 / mbedTLS 3.x builtin).
# The standard implementation is slightly larger but correct.
CONFIG_MBEDTLS_SHA256_SMALLER=n

# ── Flash + OTA ────────────────────────────────────────────────────────────────
CONFIG_FLASH=y
CONFIG_FLASH_MAP=y
CONFIG_FLASH_SIMULATOR=y
CONFIG_FLASH_SIMULATOR_DOUBLE_WRITES=y

# Do NOT enable CONFIG_BOOTLOADER_MCUBOOT — it selects USE_DT_CODE_PARTITION
# which has unsatisfied dependencies on native_sim.  Without it,
# ota_manager.c compiles with OTA_FLASH_AVAILABLE=0, and the OTA ztest cases
# that require a live flash path call ztest_test_skip() gracefully.

# ── Disable hardware not present on native_sim ─────────────────────────────────
CONFIG_GPIO=n
CONFIG_SPI=n
CONFIG_I2C=n
CONFIG_DISPLAY=n
CONFIG_WIFI=n
CONFIG_BT=n
CONFIG_USB_DEVICE_STACK=n
CONFIG_AKIRA_USB_HID=n
CONFIG_SENSOR=n

# ── Networking (not needed for tests) ─────────────────────────────────────────
CONFIG_NETWORKING=n
```

## prj-rnd.conf
```kconfig
# SPDX-License-Identifier: Apache-2.0

# Optional CCSDS randomization ztest overlay.
#
# The default test configuration keeps CONFIG_AKIRA_CCSDS_RND=n, matching the
# production default. Use this overlay when the test image should also verify
# TM frame integration of the randomization module.

CONFIG_AKIRA_CCSDS_RND=y
CONFIG_AKIRA_CCSDS_TM_RND=y
```

## boards/native_sim.overlay
```dts
/*
 * Test-only DTS overlay for native_sim.
 *
 * The native_sim board DTS already provides slot0_partition, slot1_partition
 * and storage_partition — no redefinition needed here.
 * This file intentionally left minimal to avoid duplicate-label errors.
 */
```

## src/test_akira_cfdp_service.c
```c
#include <errno.h>
#include <stdbool.h>
#include <string.h>

#include <zephyr/ztest.h>

#include "ccsds/akira_cfdp_service.h"
#include "ccsds/ccsds_cfdp_checksum.h"

#define CAPTURE_MAX_PACKETS 8u

struct packet_capture {
    uint8_t packet[CAPTURE_MAX_PACKETS][CCSDS_SPACE_PACKET_PRIMARY_HDR_LEN +
                                        CCSDS_CFDP_MAX_PDU_SIZE];
    size_t packet_len[CAPTURE_MAX_PACKETS];
    uint32_t count;
};

struct event_capture {
    ccsds_cfdp_event_t event[8];
    uint32_t count;
};

struct memory_filestore {
    const uint8_t *data;
    uint32_t size;
    uint32_t read_count;
    uint32_t close_count;
};

struct receive_file {
    bool exists;
    bool open;
    char path[CCSDS_CFDP_MAX_FILENAME_LEN + 1u];
    uint8_t data[CCSDS_CFDP_MAX_SEGMENT_SIZE + 16u];
    uint32_t size;
};

struct receive_filestore {
    struct receive_file tmp;
    struct receive_file dst;
    uint32_t write_count;
    uint32_t read_count;
    uint32_t close_count;
    uint32_t commit_count;
    uint32_t discard_count;
};

struct link_endpoint {
    struct ccsds_router *peer_router;
    uint32_t sent_count;
    uint32_t dispatch_failures;
};

static int capture_send_packet(void *user, const uint8_t *packet,
                               size_t packet_len)
{
    struct packet_capture *capture = user;

    zassert_not_null(capture);
    zassert_not_null(packet);
    zassert_true(packet_len <= sizeof(capture->packet[0]));

    if (capture->count < CAPTURE_MAX_PACKETS) {
        memcpy(capture->packet[capture->count], packet, packet_len);
        capture->packet_len[capture->count] = packet_len;
    }
    capture->count++;
    return 0;
}

static int link_send_packet(void *user, const uint8_t *packet,
                            size_t packet_len)
{
    struct link_endpoint *endpoint = user;
    int ret;

    zassert_not_null(endpoint);
    zassert_not_null(endpoint->peer_router);

    endpoint->sent_count++;
    ret =
        ccsds_router_dispatch_bytes(endpoint->peer_router, packet, packet_len);
    if (ret != 0) {
        endpoint->dispatch_failures++;
    }
    return ret;
}

static void service_event_cb(void *user, const ccsds_cfdp_event_t *event)
{
    struct event_capture *capture = user;

    zassert_not_null(capture);
    zassert_not_null(event);

    if (capture->count < ARRAY_SIZE(capture->event)) {
        capture->event[capture->count] = *event;
    }
    capture->count++;
}

static int memory_open_read(void *user, const char *path, void **handle,
                            uint32_t *size)
{
    struct memory_filestore *store = user;

    zassert_not_null(store);
    zassert_equal(strcmp(path, "src.bin"), 0);

    *handle = store;
    *size = store->size;
    return 0;
}

static int memory_read(void *user, void *handle, uint32_t offset, uint8_t *buf,
                       size_t len, size_t *nread)
{
    struct memory_filestore *store = user;
    size_t remaining;

    ARG_UNUSED(user);
    zassert_equal(handle, store);
    zassert_true(offset < store->size);
    zassert_not_null(buf);
    zassert_not_null(nread);

    remaining = store->size - offset;
    *nread = remaining < len ? remaining : len;
    memcpy(buf, &store->data[offset], *nread);
    store->read_count++;
    return 0;
}

static int memory_close(void *user, void *handle)
{
    struct memory_filestore *store = user;

    ARG_UNUSED(user);
    zassert_equal(handle, store);
    store->close_count++;
    return 0;
}

static int receive_open_write_tmp(void *user, const char *dst_path,
                                  void **handle)
{
    struct receive_filestore *store = user;
    size_t path_len;

    zassert_not_null(store);
    zassert_not_null(dst_path);
    zassert_not_null(handle);

    path_len = strlen(dst_path);
    zassert_true(path_len > 0u);
    zassert_true(path_len <= CCSDS_CFDP_MAX_FILENAME_LEN);

    memset(&store->tmp, 0, sizeof(store->tmp));
    store->tmp.exists = true;
    store->tmp.open = true;
    memcpy(store->tmp.path, dst_path, path_len + 1u);
    *handle = &store->tmp;
    return 0;
}

static int receive_read(void *user, void *handle, uint32_t offset, uint8_t *buf,
                        size_t len, size_t *nread)
{
    struct receive_filestore *store = user;
    struct receive_file *file = handle;
    uint32_t available;

    zassert_not_null(store);
    zassert_not_null(file);
    zassert_not_null(buf);
    zassert_not_null(nread);

    if (offset >= file->size) {
        *nread = 0u;
        return 0;
    }

    available = file->size - offset;
    if (len > available) {
        len = available;
    }

    memcpy(buf, &file->data[offset], len);
    *nread = len;
    store->read_count++;
    return 0;
}

static int receive_write(void *user, void *handle, uint32_t offset,
                         const uint8_t *buf, size_t len)
{
    struct receive_filestore *store = user;
    struct receive_file *file = handle;
    size_t end;

    zassert_not_null(store);
    zassert_not_null(file);
    zassert_not_null(buf);
    zassert_true(file->exists);
    zassert_true(file->open);

    end = (size_t)offset + len;
    zassert_true(end <= sizeof(file->data));

    memcpy(&file->data[offset], buf, len);
    if (end > file->size) {
        file->size = end;
    }
    store->write_count++;
    return 0;
}

static int receive_close(void *user, void *handle)
{
    struct receive_filestore *store = user;
    struct receive_file *file = handle;

    zassert_not_null(store);
    zassert_not_null(file);
    zassert_true(file->open);

    file->open = false;
    store->close_count++;
    return 0;
}

static int receive_commit_tmp(void *user, const char *dst_path)
{
    struct receive_filestore *store = user;

    zassert_not_null(store);
    zassert_not_null(dst_path);
    zassert_true(store->tmp.exists);
    zassert_false(store->tmp.open);
    zassert_equal(strcmp(store->tmp.path, dst_path), 0);

    memset(&store->dst, 0, sizeof(store->dst));
    store->dst.exists = true;
    memcpy(store->dst.path, store->tmp.path, strlen(store->tmp.path) + 1u);
    memcpy(store->dst.data, store->tmp.data, store->tmp.size);
    store->dst.size = store->tmp.size;
    memset(&store->tmp, 0, sizeof(store->tmp));
    store->commit_count++;
    return 0;
}

static int receive_discard_tmp(void *user, const char *dst_path)
{
    struct receive_filestore *store = user;

    zassert_not_null(store);
    zassert_not_null(dst_path);
    zassert_equal(strcmp(store->tmp.path, dst_path), 0);

    memset(&store->tmp, 0, sizeof(store->tmp));
    store->discard_count++;
    return 0;
}

static ccsds_cfdp_filestore_ops_t
memory_filestore_ops(struct memory_filestore *store)
{
    return (ccsds_cfdp_filestore_ops_t){
        .user = store,
        .open_read = memory_open_read,
        .read = memory_read,
        .close = memory_close,
    };
}

static ccsds_cfdp_filestore_ops_t
receive_filestore_ops(struct receive_filestore *store)
{
    return (ccsds_cfdp_filestore_ops_t){
        .user = store,
        .open_write_tmp = receive_open_write_tmp,
        .read = receive_read,
        .write = receive_write,
        .close = receive_close,
        .commit_tmp = receive_commit_tmp,
        .discard_tmp = receive_discard_tmp,
    };
}

static akira_cfdp_service_config_t
service_config(ccsds_cfdp_space_packet_send_cb_t send_packet, void *send_user,
               const ccsds_cfdp_filestore_ops_t *receive_filestore,
               ccsds_cfdp_event_cb_t event_cb, void *event_user)
{
    return (akira_cfdp_service_config_t){
        .local_entity_id = 0x12u,
        .remote_entity_id = 0x34u,
        .entity_id_len = 1u,
        .transaction_sequence_number_len = 1u,
        .initial_transaction_sequence_number = 7u,
        .local_apid = 0x251u,
        .remote_apid = 0u,
        .packet_type = CCSDS_PACKET_TYPE_TC,
        .send_packet = send_packet,
        .send_user = send_user,
        .receive_filestore = receive_filestore,
        .event_cb = event_cb,
        .event_user = event_user,
    };
}

static ccsds_cfdp_entity_config_t peer_entity_config(void)
{
    return (ccsds_cfdp_entity_config_t){
        .local_entity_id = 0x34u,
        .remote_entity_id = 0x12u,
        .entity_id_len = 1u,
        .transaction_sequence_number_len = 1u,
        .initial_transaction_sequence_number = 3u,
    };
}

static ccsds_cfdp_space_packet_adapter_config_t
peer_adapter_config(ccsds_cfdp_space_packet_send_cb_t send_packet,
                    void *send_user)
{
    return (ccsds_cfdp_space_packet_adapter_config_t){
        .remote_entity_id = 0x12u,
        .local_apid = 0x251u,
        .remote_apid = 0x251u,
        .packet_type = CCSDS_PACKET_TYPE_TC,
        .initial_sequence_count = 2u,
        .send_packet = send_packet,
        .send_user = send_user,
    };
}

static void encode_packet(uint16_t apid, const uint8_t *pdu, size_t pdu_len,
                          uint8_t *packet_buf, size_t packet_cap,
                          size_t *packet_len)
{
    const struct ccsds_space_packet packet = {
        .version = 0u,
        .type = CCSDS_PACKET_TYPE_TC,
        .secondary_header = false,
        .apid = apid,
        .sequence_flags = CCSDS_SEQUENCE_UNSEGMENTED,
        .sequence_count = 1u,
        .payload = pdu,
        .payload_len = pdu_len,
    };

    zassert_ok(
        ccsds_space_packet_encode(&packet, packet_buf, packet_cap, packet_len));
}

static ccsds_cfdp_pdu_header_t
incoming_header(enum ccsds_cfdp_pdu_type pdu_type, uint64_t sequence)
{
    return (ccsds_cfdp_pdu_header_t){
        .version = CCSDS_CFDP_VERSION_1,
        .pdu_type = pdu_type,
        .direction = CCSDS_CFDP_DIRECTION_TOWARD_RECEIVER,
        .transmission_mode = CCSDS_CFDP_TRANSMISSION_MODE_UNACKNOWLEDGED,
        .crc_flag = CCSDS_CFDP_CRC_NOT_PRESENT,
        .file_size_mode = CCSDS_CFDP_FILE_SIZE_SMALL,
        .segmentation_control =
            CCSDS_CFDP_SEGMENTATION_RECORD_BOUNDARIES_NOT_PRESERVED,
        .segment_metadata_present = false,
        .entity_id_len = 1u,
        .transaction_sequence_number_len = 1u,
        .source_entity_id = 0x34u,
        .transaction_sequence_number = sequence,
        .destination_entity_id = 0x12u,
    };
}

static void encode_incoming_metadata(uint64_t sequence, uint32_t file_size,
                                     uint8_t *buf, size_t cap, size_t *len)
{
    const char src[] = "src.bin";
    const char dst[] = "dst.bin";
    const ccsds_cfdp_metadata_pdu_t metadata = {
        .header = incoming_header(CCSDS_CFDP_PDU_TYPE_FILE_DIRECTIVE, sequence),
        .closure_requested = true,
        .checksum_type = CCSDS_CFDP_CHECKSUM_TYPE_MODULAR,
        .file_size = file_size,
        .source_filename =
            {
                .value = (const uint8_t *)src,
                .len = (uint8_t)strlen(src),
            },
        .destination_filename =
            {
                .value = (const uint8_t *)dst,
                .len = (uint8_t)strlen(dst),
            },
    };

    zassert_equal(ccsds_cfdp_encode_metadata(&metadata, buf, cap, len),
                  CCSDS_CFDP_STATUS_OK);
}

static void encode_incoming_filedata(uint64_t sequence, const uint8_t *data,
                                     size_t data_len, uint8_t *buf, size_t cap,
                                     size_t *len)
{
    const ccsds_cfdp_filedata_pdu_t filedata = {
        .header = incoming_header(CCSDS_CFDP_PDU_TYPE_FILE_DATA, sequence),
        .offset = 0u,
        .data = data,
        .data_len = data_len,
    };

    zassert_equal(ccsds_cfdp_encode_filedata(&filedata, buf, cap, len),
                  CCSDS_CFDP_STATUS_OK);
}

static void encode_incoming_eof(uint64_t sequence, uint32_t checksum,
                                uint32_t file_size, uint8_t *buf, size_t cap,
                                size_t *len)
{
    const ccsds_cfdp_eof_pdu_t eof = {
        .header = incoming_header(CCSDS_CFDP_PDU_TYPE_FILE_DIRECTIVE, sequence),
        .condition_code = CCSDS_CFDP_CONDITION_NO_ERROR,
        .file_checksum = checksum,
        .file_size = file_size,
    };

    zassert_equal(ccsds_cfdp_encode_eof(&eof, buf, cap, len),
                  CCSDS_CFDP_STATUS_OK);
}

static uint32_t modular_checksum(const uint8_t *data, size_t data_len)
{
    ccsds_cfdp_checksum_state_t state;
    uint32_t checksum;

    zassert_equal(
        ccsds_cfdp_checksum_init(&state, CCSDS_CFDP_CHECKSUM_TYPE_MODULAR),
        CCSDS_CFDP_STATUS_OK);
    zassert_equal(ccsds_cfdp_checksum_update(&state, 0u, data, data_len),
                  CCSDS_CFDP_STATUS_OK);
    zassert_equal(ccsds_cfdp_checksum_finish(&state, &checksum),
                  CCSDS_CFDP_STATUS_OK);
    return checksum;
}

ZTEST(akira_cfdp_service, test_init_static_config_wires_entity_and_adapter)
{
    struct packet_capture capture = {0};
    struct receive_filestore receive_store = {0};
    ccsds_cfdp_filestore_ops_t receive_ops =
        receive_filestore_ops(&receive_store);
    akira_cfdp_service_config_t cfg =
        service_config(capture_send_packet, &capture, &receive_ops, NULL, NULL);
    ccsds_cfdp_entity_t *entity;
    ccsds_cfdp_space_packet_adapter_t *adapter;

    zassert_equal(akira_cfdp_service_init(&cfg), CCSDS_CFDP_STATUS_OK);
    entity = akira_cfdp_service_entity();
    adapter = akira_cfdp_service_space_packet_adapter();

    zassert_equal(entity->local_entity_id, 0x12u);
    zassert_equal(entity->remote_entity_id, 0x34u);
    zassert_equal(entity->next_transaction_sequence_number, 7u);
    zassert_equal(adapter->local_apid, 0x251u);
    zassert_equal(adapter->remote_apid, 0x251u);
    zassert_equal(adapter->packet_type, CCSDS_PACKET_TYPE_TC);
    zassert_equal(adapter->sequence_count, 0u);
    zassert_equal(akira_cfdp_service_receive_filestore(), &receive_ops);
}

ZTEST(akira_cfdp_service, test_config_defaults_are_mutable_for_peer_instances)
{
    struct packet_capture capture = {0};
    akira_cfdp_service_config_t cfg;
    ccsds_cfdp_entity_t *entity;
    ccsds_cfdp_space_packet_adapter_t *adapter;

    akira_cfdp_service_config_defaults(&cfg);
    cfg.local_entity_id = 0x44u;
    cfg.remote_entity_id = 0x55u;
    cfg.local_apid = 0x321u;
    cfg.remote_apid = 0u;
    cfg.packet_type = CCSDS_PACKET_TYPE_TC;
    cfg.send_packet = capture_send_packet;
    cfg.send_user = &capture;

    zassert_equal(akira_cfdp_service_init(&cfg), CCSDS_CFDP_STATUS_OK);
    entity = akira_cfdp_service_entity();
    adapter = akira_cfdp_service_space_packet_adapter();

    zassert_equal(entity->local_entity_id, 0x44u);
    zassert_equal(entity->remote_entity_id, 0x55u);
    zassert_equal(adapter->local_apid, 0x321u);
    zassert_equal(adapter->remote_apid, 0x321u);
}

ZTEST(akira_cfdp_service, test_router_apid_dispatch_receives_file)
{
    struct ccsds_router router;
    struct packet_capture capture = {0};
    struct receive_filestore receive_store = {0};
    ccsds_cfdp_filestore_ops_t receive_ops =
        receive_filestore_ops(&receive_store);
    akira_cfdp_service_config_t cfg =
        service_config(capture_send_packet, &capture, &receive_ops, NULL, NULL);
    const uint8_t file[] = {0x10u, 0x20u, 0x30u};
    uint8_t pdu[CCSDS_CFDP_MAX_PDU_SIZE];
    uint8_t
        packet[CCSDS_SPACE_PACKET_PRIMARY_HDR_LEN + CCSDS_CFDP_MAX_PDU_SIZE];
    size_t pdu_len;
    size_t packet_len;
    uint32_t checksum;

    ccsds_router_init(&router);
    zassert_equal(akira_cfdp_service_init(&cfg), CCSDS_CFDP_STATUS_OK);
    zassert_ok(akira_cfdp_service_register_rx(&router));

    encode_incoming_metadata(0x55u, sizeof(file), pdu, sizeof(pdu), &pdu_len);
    encode_packet(0x251u, pdu, pdu_len, packet, sizeof(packet), &packet_len);
    zassert_ok(ccsds_router_dispatch_bytes(&router, packet, packet_len));

    encode_incoming_filedata(0x55u, file, sizeof(file), pdu, sizeof(pdu),
                             &pdu_len);
    encode_packet(0x251u, pdu, pdu_len, packet, sizeof(packet), &packet_len);
    zassert_ok(ccsds_router_dispatch_bytes(&router, packet, packet_len));

    checksum = modular_checksum(file, sizeof(file));
    encode_incoming_eof(0x55u, checksum, sizeof(file), pdu, sizeof(pdu),
                        &pdu_len);
    encode_packet(0x251u, pdu, pdu_len, packet, sizeof(packet), &packet_len);
    zassert_ok(ccsds_router_dispatch_bytes(&router, packet, packet_len));

    zassert_equal(receive_store.commit_count, 1u);
    zassert_true(receive_store.dst.exists);
    zassert_equal(receive_store.dst.size, sizeof(file));
    zassert_mem_equal(receive_store.dst.data, file, sizeof(file));
}

ZTEST(akira_cfdp_service, test_outbound_pdu_wraps_through_space_packet_adapter)
{
    struct packet_capture capture = {0};
    const uint8_t file[] = {0xa0u, 0xb1u, 0xc2u};
    struct memory_filestore source_store = {
        .data = file,
        .size = sizeof(file),
    };
    ccsds_cfdp_filestore_ops_t source_ops = memory_filestore_ops(&source_store);
    akira_cfdp_service_config_t cfg =
        service_config(capture_send_packet, &capture, NULL, NULL, NULL);
    ccsds_cfdp_transaction_id_t id;
    const ccsds_cfdp_put_request_t request = {
        .source_path = "src.bin",
        .destination_path = "dst.bin",
        .checksum_type = CCSDS_CFDP_CHECKSUM_TYPE_MODULAR,
        .closure_requested = false,
    };
    struct ccsds_space_packet packet;
    ccsds_cfdp_metadata_pdu_t metadata;
    size_t consumed;

    zassert_equal(akira_cfdp_service_init(&cfg), CCSDS_CFDP_STATUS_OK);
    zassert_equal(akira_cfdp_service_send_file(&source_ops, &request, &id),
                  CCSDS_CFDP_STATUS_OK);

    zassert_equal(id.source_entity_id, 0x12u);
    zassert_equal(id.transaction_sequence_number, 7u);
    zassert_true(capture.count >= 3u);
    zassert_ok(ccsds_space_packet_decode(capture.packet[0],
                                         capture.packet_len[0], &packet));
    zassert_equal(packet.apid, 0x251u);
    zassert_equal(packet.type, CCSDS_PACKET_TYPE_TC);
    zassert_equal(packet.sequence_count, 0u);
    zassert_equal(ccsds_cfdp_decode_metadata(packet.payload, packet.payload_len,
                                             &metadata, &consumed),
                  CCSDS_CFDP_STATUS_OK);
    zassert_equal(metadata.header.source_entity_id, 0x12u);
    zassert_equal(metadata.header.destination_entity_id, 0x34u);
}

ZTEST(akira_cfdp_service,
      test_loopback_receive_reaches_staging_fixture_and_complete_event)
{
    struct ccsds_router service_router;
    struct ccsds_router peer_router;
    ccsds_cfdp_space_packet_adapter_t peer_adapter;
    ccsds_cfdp_entity_t peer_entity;
    struct link_endpoint service_link = {
        .peer_router = &peer_router,
    };
    struct link_endpoint peer_link = {
        .peer_router = &service_router,
    };
    struct event_capture events = {0};
    const uint8_t file[] = {0x01u, 0x23u, 0x45u, 0x67u};
    struct memory_filestore source_store = {
        .data = file,
        .size = sizeof(file),
    };
    struct receive_filestore receive_store = {0};
    ccsds_cfdp_filestore_ops_t source_ops = memory_filestore_ops(&source_store);
    ccsds_cfdp_filestore_ops_t receive_ops =
        receive_filestore_ops(&receive_store);
    akira_cfdp_service_config_t service_cfg =
        service_config(link_send_packet, &service_link, &receive_ops,
                       service_event_cb, &events);
    ccsds_cfdp_space_packet_adapter_config_t peer_adapter_cfg =
        peer_adapter_config(link_send_packet, &peer_link);
    ccsds_cfdp_ut_ops_t peer_ut;
    ccsds_cfdp_entity_config_t peer_cfg = peer_entity_config();
    ccsds_cfdp_transaction_id_t id;
    const ccsds_cfdp_put_request_t request = {
        .source_path = "src.bin",
        .destination_path = "dst.bin",
        .checksum_type = CCSDS_CFDP_CHECKSUM_TYPE_MODULAR,
        .closure_requested = true,
    };

    ccsds_router_init(&service_router);
    ccsds_router_init(&peer_router);
    zassert_equal(akira_cfdp_service_init(&service_cfg), CCSDS_CFDP_STATUS_OK);
    zassert_ok(akira_cfdp_service_register_rx(&service_router));
    zassert_equal(
        ccsds_cfdp_space_packet_adapter_init(&peer_adapter, &peer_adapter_cfg),
        CCSDS_CFDP_STATUS_OK);
    peer_ut = ccsds_cfdp_space_packet_adapter_ut_ops(&peer_adapter);
    zassert_equal(ccsds_cfdp_entity_init(&peer_entity, &peer_cfg, &peer_ut),
                  CCSDS_CFDP_STATUS_OK);
    zassert_ok(ccsds_cfdp_space_packet_adapter_register_rx(
        &peer_adapter, &peer_router, &peer_entity, NULL));

    zassert_equal(
        ccsds_cfdp_entity_send_file(&peer_entity, &source_ops, &request, &id),
        CCSDS_CFDP_STATUS_OK);

    zassert_equal(id.source_entity_id, 0x34u);
    zassert_equal(peer_link.dispatch_failures, 0u);
    zassert_equal(service_link.dispatch_failures, 0u);
    zassert_equal(receive_store.commit_count, 1u);
    zassert_true(receive_store.dst.exists);
    zassert_mem_equal(receive_store.dst.data, file, sizeof(file));
    zassert_true(events.count >= 1u);
    zassert_equal(events.event[events.count - 1u].type,
                  CCSDS_CFDP_EVENT_COMPLETE);
    zassert_equal(events.event[events.count - 1u].status, CCSDS_CFDP_STATUS_OK);
}

ZTEST(akira_cfdp_service, test_failed_terminal_event_reaches_service_callback)
{
    struct ccsds_router router;
    struct packet_capture capture = {0};
    struct event_capture events = {0};
    struct receive_filestore receive_store = {0};
    ccsds_cfdp_filestore_ops_t receive_ops =
        receive_filestore_ops(&receive_store);
    akira_cfdp_service_config_t cfg = service_config(
        capture_send_packet, &capture, &receive_ops, service_event_cb, &events);
    const uint8_t file[] = {0xdeu, 0xadu};
    uint8_t pdu[CCSDS_CFDP_MAX_PDU_SIZE];
    uint8_t
        packet[CCSDS_SPACE_PACKET_PRIMARY_HDR_LEN + CCSDS_CFDP_MAX_PDU_SIZE];
    size_t pdu_len;
    size_t packet_len;

    ccsds_router_init(&router);
    zassert_equal(akira_cfdp_service_init(&cfg), CCSDS_CFDP_STATUS_OK);
    zassert_ok(akira_cfdp_service_register_rx(&router));

    encode_incoming_metadata(0x56u, sizeof(file), pdu, sizeof(pdu), &pdu_len);
    encode_packet(0x251u, pdu, pdu_len, packet, sizeof(packet), &packet_len);
    zassert_ok(ccsds_router_dispatch_bytes(&router, packet, packet_len));

    encode_incoming_filedata(0x56u, file, sizeof(file), pdu, sizeof(pdu),
                             &pdu_len);
    encode_packet(0x251u, pdu, pdu_len, packet, sizeof(packet), &packet_len);
    zassert_ok(ccsds_router_dispatch_bytes(&router, packet, packet_len));

    encode_incoming_eof(0x56u, 0x12345678u, sizeof(file), pdu, sizeof(pdu),
                        &pdu_len);
    encode_packet(0x251u, pdu, pdu_len, packet, sizeof(packet), &packet_len);
    zassert_equal(ccsds_router_dispatch_bytes(&router, packet, packet_len),
                  -EINVAL);

    zassert_equal(receive_store.commit_count, 0u);
    zassert_equal(receive_store.discard_count, 1u);
    zassert_true(events.count >= 1u);
    zassert_equal(events.event[events.count - 1u].type,
                  CCSDS_CFDP_EVENT_FAILED);
    zassert_equal(events.event[events.count - 1u].status,
                  CCSDS_CFDP_STATUS_CHECKSUM_FAILURE);
}

ZTEST_SUITE(akira_cfdp_service, NULL, NULL, NULL, NULL, NULL);
```

## src/test_app_lifecycle.c
```c
/*
 * test_app_lifecycle.c
 * ztest suite: app_lifecycle
 *
 * Tests for the app_manager state machine (app_state_t transitions).
 * Operates entirely on app_entry_t structs in RAM — no WAMR, no flash.
 *
 * Sources exercised:
 *   src/runtime/app_manager/app_manager.h  — types, constants
 *   (state transitions are validated against the enum values)
 */

#include <zephyr/ztest.h>
#include <string.h>

#include "app_manager/app_manager.h"
#include "akira_runtime.h"  /* akira_app_status_t */

/* ── helpers ─────────────────────────────────────────────────────────────── */

/** Initialise an app_entry_t as if it was just created by the installer. */
static void make_new_entry(app_entry_t *e, const char *name)
{
	memset(e, 0, sizeof(*e));
	strncpy(e->name, name, APP_NAME_MAX_LEN - 1);
	e->state      = APP_STATE_NEW;
	e->container_id = -1;
}

/* ── state machine enum sanity ───────────────────────────────────────────── */

ZTEST(app_lifecycle, test_state_enum_ordering)
{
	/*
	 * The install/run lifecycle only makes sense with this ordering.
	 * If someone reorders the enum the CI will catch it here.
	 */
	zassert_equal(APP_STATE_NEW,       0, "APP_STATE_NEW must be 0");
	zassert_true(APP_STATE_INSTALLED  > APP_STATE_NEW,
		     "INSTALLED must follow NEW");
	zassert_true(APP_STATE_RUNNING    > APP_STATE_INSTALLED,
		     "RUNNING must follow INSTALLED");
	zassert_true(APP_STATE_STOPPED    > APP_STATE_RUNNING,
		     "STOPPED must follow RUNNING");
	zassert_true(APP_STATE_ERROR      > APP_STATE_STOPPED,
		     "ERROR must follow STOPPED");
	zassert_true(APP_STATE_FAILED     > APP_STATE_ERROR,
		     "FAILED must follow ERROR");
}

/* ── akira_app_status_t (runtime layer) enum sanity ─────────────────────── */

ZTEST(app_lifecycle, test_runtime_status_enum_ordering)
{
	zassert_equal(AKIRA_APP_STATUS_CREATED, 0,
		      "CREATED must be 0");
	zassert_true(AKIRA_APP_STATUS_RUNNING > AKIRA_APP_STATUS_CREATED,
		     "RUNNING must follow CREATED");
	zassert_true(AKIRA_APP_STATUS_EXITED  > AKIRA_APP_STATUS_RUNNING,
		     "EXITED must follow RUNNING");
	zassert_true(AKIRA_APP_STATUS_STOPPED > AKIRA_APP_STATUS_EXITED,
		     "STOPPED must follow EXITED");
	zassert_true(AKIRA_APP_STATUS_ERROR   > AKIRA_APP_STATUS_STOPPED,
		     "ERROR must follow STOPPED");
}

/* ── NEW → INSTALLED ─────────────────────────────────────────────────────── */

ZTEST(app_lifecycle, test_initial_state_new)
{
	app_entry_t e;

	make_new_entry(&e, "hello");

	zassert_equal(e.state, APP_STATE_NEW, "freshly created must be NEW");
	zassert_equal(e.container_id, -1,
		      "container_id must be -1 when not loaded");
}

ZTEST(app_lifecycle, test_transition_new_to_installed)
{
	app_entry_t e;

	make_new_entry(&e, "hello");
	e.state = APP_STATE_INSTALLED; /* installer sets this after writing files */

	zassert_equal(e.state, APP_STATE_INSTALLED,
		      "state should be INSTALLED after install step");
}

/* ── INSTALLED → RUNNING ─────────────────────────────────────────────────── */

ZTEST(app_lifecycle, test_transition_installed_to_running)
{
	app_entry_t e;

	make_new_entry(&e, "demo");
	e.state = APP_STATE_INSTALLED;

	/* Launcher sets state to RUNNING before spawning thread */
	e.state = APP_STATE_RUNNING;

	zassert_equal(e.state, APP_STATE_RUNNING,
		      "state should be RUNNING after start");
}

/* ── RUNNING → STOPPED ───────────────────────────────────────────────────── */

ZTEST(app_lifecycle, test_transition_running_to_stopped)
{
	app_entry_t e;

	make_new_entry(&e, "demo");
	e.state = APP_STATE_RUNNING;

	e.state = APP_STATE_STOPPED;

	zassert_equal(e.state, APP_STATE_STOPPED,
		      "state should be STOPPED after graceful stop");
}

/* ── RUNNING → ERROR ─────────────────────────────────────────────────────── */

ZTEST(app_lifecycle, test_transition_running_to_error)
{
	app_entry_t e;

	make_new_entry(&e, "buggy");
	e.state = APP_STATE_RUNNING;

	/* Simulate crash handler */
	e.state = APP_STATE_ERROR;
	e.crash_count++;

	zassert_equal(e.state, APP_STATE_ERROR,
		      "state should be ERROR after crash");
	zassert_equal(e.crash_count, 1U, "crash_count should increment");
}

/* ── ERROR → FAILED (max retries exceeded) ───────────────────────────────── */

ZTEST(app_lifecycle, test_transition_error_to_failed)
{
	app_entry_t e;

	make_new_entry(&e, "crashloop");
	e.state = APP_STATE_ERROR;
	e.crash_count = CONFIG_AKIRA_APP_MAX_RETRIES;

	/* Manager marks FAILED when retries exhausted */
	if (e.crash_count >= CONFIG_AKIRA_APP_MAX_RETRIES) {
		e.state = APP_STATE_FAILED;
	}

	zassert_equal(e.state, APP_STATE_FAILED,
		      "should be FAILED after max retries");
}

/* ── field limits ────────────────────────────────────────────────────────── */

ZTEST(app_lifecycle, test_name_length_limit)
{
	app_entry_t e;

	make_new_entry(&e, "x");

	/* APP_NAME_MAX_LEN includes the NUL — the stored name must be
	 * NUL-terminated within the field */
	size_t len = strlen(e.name);

	zassert_true(len < APP_NAME_MAX_LEN,
		     "name must be NUL-terminated within the field");
}

ZTEST(app_lifecycle, test_defaults)
{
	app_entry_t e;

	make_new_entry(&e, "defaults_test");

	zassert_equal(e.crash_count, 0U, "crash_count must start at 0");
	zassert_equal(e.is_preloaded, false, "is_preloaded must start false");
	zassert_equal(e.container_id, -1, "container_id must start at -1");
}

/* ── restart config ──────────────────────────────────────────────────────── */

ZTEST(app_lifecycle, test_restart_config_defaults)
{
	app_entry_t e;

	make_new_entry(&e, "restart_test");

	/*
	 * Default restart config: enabled=false (no auto-restart unless
	 * the manifest explicitly requests it).
	 */
	zassert_false(e.restart.enabled,
		      "restart should be disabled by default");
}

ZTEST_SUITE(app_lifecycle, NULL, NULL, NULL, NULL, NULL);
```

## src/test_ccsds_shell.c
```c
#include <errno.h>

#include <zephyr/kernel.h>
#include <zephyr/ztest.h>

#include "ccsds/ccsds_shell.h"
#include "ccsds/ccsds_tm_frame.h"

bool ccsds_tm_frame_test_is_running(void);
bool ccsds_tm_frame_test_run_cycle(k_timeout_t *next_delay, uint8_t *vcid);
int ccsds_tm_frame_test_get_clcw(uint32_t *clcw);

#define TEST_CCSDS_SHELL_IDLE_VCID 7u
#define TEST_CCSDS_SHELL_IDLE_FHP 0x7feu

static ccsds_tm_route_mask_t get_vc_route(uint8_t vcid)
{
    ccsds_tm_route_mask_t route_mask;

    zassert_ok(ccsds_tm_frame_get_vc_route(vcid, &route_mask));

    return route_mask;
}

static void shell_setup(void *fixture)
{
    ARG_UNUSED(fixture);

    ccsds_shell_tm_stop();
}

ZTEST(ccsds_shell, test_init_registers_log_destination_without_default_routes)
{
    struct ccsds_shell_tm_status status;
    uint8_t vcid;

    zassert_ok(ccsds_shell_tm_init());

    ccsds_shell_tm_get_status(&status);
    zassert_true(status.initialized);
    zassert_false(status.running);
    zassert_equal(status.log_route_calls, 0u);
    zassert_equal(get_vc_route(0u), CCSDS_TM_ROUTE_NONE);
    zassert_equal(get_vc_route(TEST_CCSDS_SHELL_IDLE_VCID),
                  CCSDS_TM_ROUTE_NONE);

    zassert_false(ccsds_tm_frame_test_run_cycle(NULL, &vcid));
    zassert_equal(vcid, TEST_CCSDS_SHELL_IDLE_VCID);

    ccsds_shell_tm_get_status(&status);
    zassert_equal(status.log_route_calls, 0u);

    zassert_ok(ccsds_shell_tm_route_add(TEST_CCSDS_SHELL_IDLE_VCID,
                                        CCSDS_TM_ROUTE_LOG));
    zassert_false(ccsds_tm_frame_test_run_cycle(NULL, &vcid));
    zassert_equal(vcid, TEST_CCSDS_SHELL_IDLE_VCID);

    ccsds_shell_tm_get_status(&status);
    zassert_equal(status.log_route_calls, 1u);
    zassert_equal(status.last_vcid, TEST_CCSDS_SHELL_IDLE_VCID);
    zassert_true(status.last_len > 0u);
    zassert_equal(status.last_mcfc, 1u);
    zassert_equal(status.last_vcfc, 1u);
    zassert_equal(status.last_fhp, TEST_CCSDS_SHELL_IDLE_FHP);
    zassert_true(status.last_cadu);
}

ZTEST(ccsds_shell, test_init_registers_tc_clcw_provider_without_udp)
{
    uint32_t clcw = 0xffffffffu;

    zassert_ok(ccsds_shell_tm_init());
    zassert_ok(ccsds_tm_frame_test_get_clcw(&clcw));
    zassert_equal(clcw, 0x01000000u);
}

ZTEST(ccsds_shell, test_start_and_stop_control_tm_generator)
{
    struct ccsds_shell_tm_status status;

    zassert_ok(ccsds_shell_tm_init());
    zassert_ok(ccsds_shell_tm_start());
    zassert_true(ccsds_tm_frame_test_is_running());

    ccsds_shell_tm_get_status(&status);
    zassert_true(status.initialized);
    zassert_true(status.running);
    zassert_equal(status.time_vcid, 0u);

    ccsds_shell_tm_stop();
    zassert_false(ccsds_tm_frame_test_is_running());

    ccsds_shell_tm_get_status(&status);
    zassert_true(status.initialized);
    zassert_false(status.running);
}

ZTEST(ccsds_shell, test_route_name_parsing_supports_log_and_udp)
{
    ccsds_tm_route_mask_t route_mask;

    zassert_ok(ccsds_shell_tm_parse_route_mask("log", &route_mask));
    zassert_equal(route_mask, CCSDS_TM_ROUTE_LOG);

    zassert_ok(ccsds_shell_tm_parse_route_mask("udp", &route_mask));
    zassert_equal(route_mask, CCSDS_TM_ROUTE_UDP);

    zassert_ok(ccsds_shell_tm_parse_route_mask("log,udp", &route_mask));
    zassert_equal(route_mask, CCSDS_TM_ROUTE_LOG | CCSDS_TM_ROUTE_UDP);

    zassert_equal(ccsds_shell_tm_parse_route_mask("serial", &route_mask),
                  -EINVAL);
}

ZTEST(ccsds_shell, test_route_availability_reports_build_destinations)
{
    zassert_true(ccsds_shell_tm_route_available(CCSDS_TM_ROUTE_LOG));
#ifdef CONFIG_NETWORKING
    zassert_true(ccsds_shell_tm_route_available(CCSDS_TM_ROUTE_UDP));
#else
    zassert_false(ccsds_shell_tm_route_available(CCSDS_TM_ROUTE_UDP));
#endif
    zassert_false(ccsds_shell_tm_route_available(CCSDS_TM_ROUTE_NONE));
    zassert_false(ccsds_shell_tm_route_available(CCSDS_TM_ROUTE_LOG |
                                                 CCSDS_TM_ROUTE_UDP));
}

ZTEST(ccsds_shell, test_route_set_add_del_and_clear_log_mask)
{
    zassert_ok(ccsds_shell_tm_init());

    zassert_equal(get_vc_route(0u), CCSDS_TM_ROUTE_NONE);

    zassert_ok(ccsds_shell_tm_route_add(0u, CCSDS_TM_ROUTE_LOG));
    zassert_equal(get_vc_route(0u), CCSDS_TM_ROUTE_LOG);

    zassert_ok(ccsds_shell_tm_route_del(0u, CCSDS_TM_ROUTE_LOG));
    zassert_equal(get_vc_route(0u), CCSDS_TM_ROUTE_NONE);

    zassert_ok(ccsds_shell_tm_route_set(0u, CCSDS_TM_ROUTE_LOG));
    zassert_equal(get_vc_route(0u), CCSDS_TM_ROUTE_LOG);
}

ZTEST(ccsds_shell, test_route_add_reports_combined_masks_when_available)
{
    zassert_ok(ccsds_shell_tm_init());
    zassert_ok(ccsds_shell_tm_route_set(0u, CCSDS_TM_ROUTE_LOG));

#ifdef CONFIG_NETWORKING
    zassert_ok(ccsds_shell_tm_route_add(0u, CCSDS_TM_ROUTE_UDP));
    zassert_equal(get_vc_route(0u), CCSDS_TM_ROUTE_LOG | CCSDS_TM_ROUTE_UDP);
#else
    zassert_equal(ccsds_shell_tm_route_add(0u, CCSDS_TM_ROUTE_UDP),
                  -ENOTSUP);
    zassert_equal(get_vc_route(0u), CCSDS_TM_ROUTE_LOG);
#endif
}

ZTEST(ccsds_shell, test_route_helper_reports_current_masks)
{
    ccsds_tm_route_mask_t route_mask;

    zassert_ok(ccsds_shell_tm_init());
    zassert_ok(ccsds_shell_tm_route_clear(1u));
    zassert_ok(ccsds_tm_frame_get_vc_route(1u, &route_mask));
    zassert_equal(route_mask, CCSDS_TM_ROUTE_NONE);

    zassert_ok(ccsds_shell_tm_route_set(1u, CCSDS_TM_ROUTE_LOG));
    zassert_ok(ccsds_tm_frame_get_vc_route(1u, &route_mask));
    zassert_equal(route_mask, CCSDS_TM_ROUTE_LOG);

    zassert_equal(ccsds_tm_frame_get_vc_route(8u, &route_mask), -EINVAL);
}

ZTEST(ccsds_shell, test_udp_route_is_unavailable_without_networking)
{
    zassert_ok(ccsds_shell_tm_init());

#ifdef CONFIG_NETWORKING
    zassert_ok(ccsds_shell_tm_route_set(0u, CCSDS_TM_ROUTE_UDP));
    zassert_equal(get_vc_route(0u), CCSDS_TM_ROUTE_UDP);
#else
    zassert_equal(ccsds_shell_tm_route_set(0u, CCSDS_TM_ROUTE_UDP),
                  -ENOTSUP);
    zassert_equal(get_vc_route(0u), CCSDS_TM_ROUTE_NONE);
#endif
}

ZTEST_SUITE(ccsds_shell, NULL, NULL, shell_setup, shell_setup, NULL);
```

## src/test_manifest_parser.c
```c
/*
 * test_manifest_parser.c
 * ztest suite: manifest_parser
 *
 * Tests for src/runtime/manifest_parser.c
 * Exercises manifest_parse_json() and manifest_parse_wasm_section().
 */

#include <zephyr/ztest.h>
#include <string.h>
#include <stdint.h>
#include "manifest_parser.h"
#include "security.h"  /* cap bit-mask constants */

/* ── helpers ─────────────────────────────────────────────────────────────── */

/**
 * Build a minimal WASM binary that contains a single custom section
 * named ".akira.manifest" with @p json as its payload.
 * @p buf must be large enough (json_len + 32 bytes of overhead).
 */
static void build_wasm_with_manifest(uint8_t *buf, size_t *out_len,
				     const char *json)
{
	const char *section_name = ".akira.manifest";
	uint8_t     name_len     = (uint8_t)strlen(section_name); /* 15 */
	size_t      json_len     = strlen(json);

	/* section body = LEB128(name_len) + name + json */
	uint32_t body = 1u + name_len + (uint32_t)json_len;

	size_t pos = 0;

	/* WASM magic (\0asm) + version (1) */
	buf[pos++] = 0x00; buf[pos++] = 0x61;
	buf[pos++] = 0x73; buf[pos++] = 0x6D;
	buf[pos++] = 0x01; buf[pos++] = 0x00;
	buf[pos++] = 0x00; buf[pos++] = 0x00;

	/* Custom section id = 0 */
	buf[pos++] = 0x00;

	/* Section size as LEB128 (up to 2 bytes covers < 16383 bytes) */
	if (body < 128) {
		buf[pos++] = (uint8_t)body;
	} else {
		buf[pos++] = (uint8_t)((body & 0x7F) | 0x80);
		buf[pos++] = (uint8_t)(body >> 7);
	}

	/* Name length (fits in 1 byte) */
	buf[pos++] = name_len;
	/* Name */
	memcpy(&buf[pos], section_name, name_len);
	pos += name_len;
	/* JSON payload */
	memcpy(&buf[pos], json, json_len);
	pos += json_len;

	*out_len = pos;
}

/* ── test cases ──────────────────────────────────────────────────────────── */

ZTEST(manifest_parser, test_valid_json)
{
	const char *json =
		"{\"name\":\"myapp\",\"version\":\"1.0.0\","
		"\"memory_quota\":65536,"
		"\"capabilities\":[\"display.write\",\"storage.read\"]}";

	akira_manifest_t m;
	int rc = manifest_parse_json(json, strlen(json), &m);

	zassert_equal(rc, 0, "parse should succeed, got %d", rc);
	zassert_true(m.valid, "manifest.valid should be true");
	zassert_equal(m.memory_quota, 65536U, "memory_quota mismatch");
	zassert_str_equal(m.name, "myapp", "name mismatch");
	zassert_str_equal(m.version, "1.0.0", "version mismatch");
	zassert_true(m.cap_mask & AKIRA_CAP_DISPLAY_WRITE,
		     "display.write cap missing");
	zassert_true(m.cap_mask & AKIRA_CAP_STORAGE_READ,
		     "storage.read cap missing");
}

ZTEST(manifest_parser, test_invalid_json)
{
	const char *bad = "not_json_at_all";

	akira_manifest_t m;
	int rc = manifest_parse_json(bad, strlen(bad), &m);

	zassert_not_equal(rc, 0, "bad JSON should fail, got rc=%d", rc);
	zassert_false(m.valid, "manifest.valid should be false");
}

ZTEST(manifest_parser, test_truncated_json)
{
	/* Truncated mid-string — parser must not crash */
	const char *trunc = "{\"name\":\"app\",\"capabilities\":[\"display.w";

	akira_manifest_t m;
	/* Return value may be -EINVAL or 0 with partial parse — must not hang */
	manifest_parse_json(trunc, strlen(trunc), &m);
	/* No crash is the primary assertion; valid must not be inconsistently set */
}

ZTEST(manifest_parser, test_bad_capability)
{
	/* Unknown capability strings must be silently ignored (mask stays 0) */
	const char *json =
		"{\"capabilities\":[\"foo.bar\",\"unknown.cap\"]}";

	akira_manifest_t m;
	int rc = manifest_parse_json(json, strlen(json), &m);

	zassert_equal(rc, 0, "parse should succeed");
	zassert_equal(m.cap_mask, 0U,
		      "unknown caps should contribute 0 to mask, got 0x%08x",
		      m.cap_mask);
}

ZTEST(manifest_parser, test_oversize_quota)
{
	/*
	 * Largest uint32 value in JSON (4294967295).  Parser must not crash
	 * and must set memory_quota to the parsed value without overflowing
	 * into adjacent fields.
	 */
	const char *json =
		"{\"memory_quota\":4294967295,\"name\":\"big\"}";

	akira_manifest_t m;
	int rc = manifest_parse_json(json, strlen(json), &m);

	/* Parser should succeed or return -EINVAL — either is acceptable.
	 * The critical invariant is that name[] is not corrupted. */
	if (rc == 0) {
		zassert_str_equal(m.name, "big",
				  "name corrupted by large quota");
	}
}

ZTEST(manifest_parser, test_missing_name)
{
	/* name field omitted — should parse OK with empty name */
	const char *json =
		"{\"version\":\"2.0\",\"capabilities\":[\"timer\"]}";

	akira_manifest_t m;
	int rc = manifest_parse_json(json, strlen(json), &m);

	zassert_equal(rc, 0, "parse should succeed without name");
	zassert_true(m.valid, "manifest.valid should be true");
	zassert_equal(m.name[0], '\0', "name should be empty string");
	zassert_true(m.cap_mask & AKIRA_CAP_TIMER, "timer cap missing");
}

ZTEST(manifest_parser, test_null_inputs)
{
	akira_manifest_t m;

	zassert_not_equal(manifest_parse_json(NULL, 10, &m), 0,
			  "NULL json should fail");
	zassert_not_equal(manifest_parse_json("{}", 2, NULL), 0,
			  "NULL manifest should fail");
	zassert_not_equal(manifest_parse_json("{}", 0, &m), 0,
			  "zero length should fail");
}

ZTEST(manifest_parser, test_wasm_section)
{
	const char *json =
		"{\"name\":\"wtest\",\"version\":\"0.1\","
		"\"memory_quota\":4096,"
		"\"capabilities\":[\"storage.write\",\"timer\"]}";

	uint8_t wasm_buf[256];
	size_t  wasm_len = 0;

	build_wasm_with_manifest(wasm_buf, &wasm_len, json);
	zassert_true(wasm_len > 8, "WASM binary must be larger than header");

	akira_manifest_t m;
	int rc = manifest_parse_wasm_section(wasm_buf, wasm_len, &m);

	zassert_equal(rc, 0, "wasm section parse failed: %d", rc);
	zassert_true(m.valid, "manifest.valid should be true");
	zassert_str_equal(m.name, "wtest", "name mismatch");
	zassert_equal(m.memory_quota, 4096U, "memory_quota mismatch");
	zassert_true(m.cap_mask & AKIRA_CAP_STORAGE_WRITE,
		     "storage.write cap missing");
	zassert_true(m.cap_mask & AKIRA_CAP_TIMER, "timer cap missing");
}

ZTEST(manifest_parser, test_wasm_no_manifest_section)
{
	/* A WASM binary with no custom section — should return -ENOENT */
	static const uint8_t minimal_wasm[] = {
		0x00, 0x61, 0x73, 0x6D, /* magic */
		0x01, 0x00, 0x00, 0x00  /* version */
	};

	akira_manifest_t m;
	int rc = manifest_parse_wasm_section(minimal_wasm, sizeof(minimal_wasm), &m);

	zassert_equal(rc, -ENOENT,
		      "expected -ENOENT for missing section, got %d", rc);
}

ZTEST_SUITE(manifest_parser, NULL, NULL, NULL, NULL, NULL);
```
