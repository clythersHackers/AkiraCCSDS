## boards/akiraconsole/Kconfig.akiraconsole
```kconfig
# Akira Console board configuration
# Copyright (c) 2026 AkiraOS
# SPDX-License-Identifier: Apache-2.0

config BOARD_AKIRACONSOLE
	select SOC_ESP32S3_MINI_N8
	select SOC_ESP32S3_PROCPU if BOARD_ESP32S3_DEVKITM_ESP32S3_PROCPU
	select SOC_ESP32S3_APPCPU if BOARD_ESP32S3_DEVKITM_ESP32S3_APPCPU
```

## boards/akiraconsole/board.yml
```yaml
board:
  name: akiraconsole
  full_name: Akira Console (ESP32-S3-DevKitM)
  vendor: PenEngineering
  socs:
  - name: esp32s3
```

## boards/esp32s3_super_mini/Kconfig.esp32s3_super_mini
```kconfig
# ESP32-S3 Super Mini board configuration
# Copyright (c) 2026 AkiraOS
# SPDX-License-Identifier: Apache-2.0

config BOARD_ESP32S3_SUPER_MINI
	select SOC_ESP32S3_MINI_N8
```

## boards/esp32s3_super_mini/esp32s3_super_mini_esp32s3_procpu_defconfig
```kconfig
# SPDX-License-Identifier: Apache-2.0

# SoC Configuration
CONFIG_SOC_SERIES_ESP32S3=y
CONFIG_SOC_ESP32S3_PROCPU=y

# Flash Configuration
CONFIG_ESPTOOLPY_FLASHSIZE_4MB=y

# Console Configuration - Using native USB CDC
CONFIG_USB_DEVICE_STACK=y
CONFIG_USB_DEVICE_INITIALIZE_AT_BOOT=y
CONFIG_SHELL_BACKEND_SERIAL_INIT_PRIORITY=51
CONFIG_UART_CONSOLE=y
CONFIG_CONSOLE=y
CONFIG_SERIAL=y

# Basic Peripherals
CONFIG_GPIO=y
CONFIG_CLOCK_CONTROL=y

# Pinctrl
CONFIG_PINCTRL=y
```

## boards/esp32s3_super_mini_esp32s3_procpu.conf
```kconfig
# BOARD_ZEPHYR: esp32s3_super_mini/esp32s3/procpu
# BOARD_CHIP: esp32s3
# BOARD_DESC: ESP32-S3 Super Mini
# BOARD_ALIAS: esp32s3_super_mini

# =============================================================================
# ESP32-S3 Super Mini Board Configuration for AkiraOS
# =============================================================================

CONFIG_SERIAL=y
CONFIG_CONSOLE=y
CONFIG_UART_CONSOLE=y

###############################################################################
# Display — disabled on ESP32-S3 Super Mini (no display hardware)
###############################################################################
CONFIG_DISPLAY=n
CONFIG_MIPI_DBI=n
CONFIG_MIPI_DBI_SPI=n
CONFIG_AKIRA_FONTS_IN_PSRAM=n
CONFIG_AKIRA_FRAMEBUFFER_IN_PSRAM=n
```

## boards/template_procpu.conf
```kconfig
# FIXME: Rename to <your-board-identifier-with-slashes-replaced-by-underscores>.conf
# Example: my_sensor_node_nrf54l15_cpuapp.conf
#
# Application-level Kconfig overlay for your board.
# Applied on top of prj.conf by the AkiraOS build system.
# Start by uncommenting only what your hardware actually has.
# Remove sections for peripherals not present.
#
# Reference implementation: boards/akiraconsole_prod_esp32s3_procpu.conf

# =============================================================================
# PSRAM (ESP32 family only)
# =============================================================================
# FIXME: Uncomment if your ESP32 module includes PSRAM (e.g. N8R8, N16R8).
# Required for running more than 2 WASM apps concurrently.
# See docs/hardware/min-hw-requirements.md for SRAM tier breakdown.
#
# CONFIG_ESP_SPIRAM=y
# CONFIG_ESP_SPIRAM_SIZE=8388608          # FIXME: 2097152 (2MB) | 4194304 (4MB) | 8388608 (8MB)
# CONFIG_ESP_SPIRAM_HEAP_SIZE=4194304     # FIXME: typically half of SPIRAM_SIZE
# CONFIG_SPIRAM_MODE_OCT=y               # FIXME: OCT for N8R8/N16R8; QUAD for older modules
# CONFIG_AKIRA_PSRAM=y
# CONFIG_SPIRAM_TYPE_ESPPSRAM64=y
# CONFIG_SPIRAM_SPEED_80M=y
# CONFIG_MEMC=y
# CONFIG_SPIRAM_RODATA=y
# CONFIG_SPIRAM_FETCH_INSTRUCTIONS=y
# CONFIG_ESP_SPIRAM_MEMTEST=n

# =============================================================================
# Memory — tune these for your SRAM budget
# See docs/hardware/min-hw-requirements.md for tier guidance.
# =============================================================================
CONFIG_HEAP_MEM_POOL_SIZE=65536          # FIXME: 32768 (min) | 65536 (standard) | 131072 (full)
CONFIG_MAIN_STACK_SIZE=4096
CONFIG_SYSTEM_WORKQUEUE_STACK_SIZE=4096  # FIXME: 1024 (min) | 4096 (standard+)
CONFIG_SHELL_STACK_SIZE=4096             # FIXME: reduce to 2048 if tight on SRAM
# CONFIG_SHARED_MULTI_HEAP=y            # FIXME: uncomment if using PSRAM heap

# =============================================================================
# Flash geometry (ESP32 family only)
# =============================================================================
# FIXME: Uncomment and set for your flash chip.
# CONFIG_ESPTOOLPY_FLASHSIZE_4MB=y      # 4 MB
# CONFIG_ESPTOOLPY_FLASHSIZE_8MB=y      # 8 MB
# CONFIG_ESPTOOLPY_FLASHSIZE_16MB=y     # 16 MB
# CONFIG_ESPTOOLPY_FLASHMODE_DIO=y      # FIXME: DIO (most modules) | QIO | OPI
# CONFIG_ESPTOOLPY_FLASHFREQ_40M=y      # FIXME: 20M | 40M | 80M

# =============================================================================
# WASM Runtime
# =============================================================================
# FIXME: Set heap and container limits to fit your SRAM tier.
# WAMR_HEAP_SIZE is a soft quota hint (not a real pool); actual allocation
# comes from CONFIG_HEAP_MEM_POOL_SIZE (SRAM) or PSRAM heap.
CONFIG_AKIRA_WASM_RUNTIME=y
CONFIG_WAMR_AOT_SUPPORT=n               # FIXME: set =y for ESP32-S3 or native_sim
CONFIG_WAMR_HEAP_SIZE=131072            # FIXME: 65536 (min) | 131072 (std) | 1048576 (PSRAM)
CONFIG_AKIRA_WASM_APP_STACK_SIZE=8192   # FIXME: 8192 (min) | 16384 (with PSRAM)
CONFIG_MAX_CONTAINERS=2                 # FIXME: 1 (min tier) | 2 (std) | 8 (full with PSRAM)

# =============================================================================
# Bluetooth
# =============================================================================
# FIXME: Uncomment if your SoC has a BLE radio.
# CONFIG_BT=y
# CONFIG_BT_PERIPHERAL=y
# CONFIG_BT_DEVICE_NAME="FIXME_BOARD"     # FIXME: advertised BLE device name (max 32 chars)
# CONFIG_BT_DEVICE_NAME_DYNAMIC=y
# CONFIG_BT_DEVICE_NAME_MAX=32
# CONFIG_BT_MAX_CONN=1
# CONFIG_BT_L2CAP_TX_MTU=300
# CONFIG_BT_BUF_ACL_RX_SIZE=300
# CONFIG_BT_BUF_ACL_TX_SIZE=300
# CONFIG_BT_GATT_CLIENT=y
# CONFIG_BT_ATT_PREPARE_COUNT=1
# CONFIG_BT_GATT_DYNAMIC_DB=y
# CONFIG_BT_RX_STACK_SIZE=2048
# CONFIG_BT_HCI_TX_STACK_SIZE=1024
# CONFIG_BT_SMP=y
# CONFIG_BT_BONDING=y

# =============================================================================
# WiFi (ESP32 family only — use Zephyr Wi-Fi API for other SoCs)
# =============================================================================
# FIXME: Uncomment for ESP32 boards.
# CONFIG_WIFI=y
# CONFIG_WIFI_ESP32=y
# CONFIG_ESP32_WIFI_STATIC_RX_BUFFER_COUNT=10
# CONFIG_ESP32_WIFI_DYNAMIC_RX_BUFFER_COUNT=32
# CONFIG_ESP32_WIFI_TX_BUFFER=DYNAMIC
# CONFIG_ESP32_WIFI_SPIRAM_BSS_DATA=y      # FIXME: requires PSRAM

# =============================================================================
# Display
# =============================================================================
# FIXME: Uncomment CONFIG_DISPLAY=y plus ONE driver symbol.
# Zephyr driver dependencies (MIPI_DBI, MIPI_DBI_SPI, …) auto-enable from DTS.
# CMakeLists.txt appends the matching overlay for ILI9341 and Sharp boards.
#
# CONFIG_DISPLAY=y
# CONFIG_ST7789V=y              # ST7789V / GC9A01 240×320 TFT (MIPI-DBI SPI)
#
# CONFIG_DISPLAY=y
# CONFIG_AKIRA_ILI9341_DRIVER=y # ILI9341 240×320 TFT (Akira driver)
#
# CONFIG_DISPLAY=y
# CONFIG_LS0XX=y                # Sharp LS027B7DH01 400×240 Memory LCD

# =============================================================================
# USB HID (requires USB OTG hardware)
# =============================================================================
# FIXME: Uncomment if your board has USB OTG.
# CONFIG_USB_DEVICE_STACK_NEXT=y
# CONFIG_AKIRA_USB=y
# CONFIG_AKIRA_USB_HID=y
# CONFIG_AKIRA_HID=y
# CONFIG_AKIRA_HID_MODE_KB_MOUSE=y         # FIXME: remove if only one mode needed
# CONFIG_UDC_DWC2_STACK_SIZE=4096

# =============================================================================
# ADC
# =============================================================================
# FIXME: Uncomment if ADC channels are present and used.
# CONFIG_ADC=y
# CONFIG_ADC_CONFIGURABLE_INPUTS=y

# =============================================================================
# PWM
# =============================================================================
# FIXME: Uncomment if PWM outputs are used (backlight, motor, buzzer, etc.)
# CONFIG_PWM=y

# =============================================================================
# SD Card / Storage
# =============================================================================
# FIXME: Uncomment if an SD card is fitted.
# CONFIG_AKIRA_SD_CARD=y
# CONFIG_AKIRA_APP_SOURCE_SD=y
# CONFIG_AKIRA_SD_XIP=y

# =============================================================================
# Sensors
# =============================================================================
# FIXME: Uncomment sensors fitted on your hardware.
# CONFIG_SENSOR=y
# CONFIG_BME280=y                     # Bosch BME280 temperature/pressure/humidity
# CONFIG_LSM6DSL=y                    # ST LSM6DSL IMU (or AKIRA_LSM6DS3_DRIVER for custom)
# CONFIG_LIS2DH=y                     # ST LIS2DH12 accelerometer

# =============================================================================
# Logging
# =============================================================================
CONFIG_LOG=y
CONFIG_LOG_DEFAULT_LEVEL=3
CONFIG_LOG_MAX_LEVEL=3
# CONFIG_LOG_MODE_IMMEDIATE=y         # FIXME: uncomment for real-time debug output
                                      #        (costs ~4KB SRAM for log buffer)
```

## tests/testcase.yaml
```yaml
tests:
  akiraos.tests:
    tags: akiraos security ota manifest lifecycle
    platform_allow: native_sim
    harness: ztest
    timeout: 120
    min_ram: 512
    filter: CONFIG_ZTEST
  akiraos.tests.ccsds_rnd:
    tags: akiraos ccsds randomization
    platform_allow: native_sim
    harness: ztest
    timeout: 120
    min_ram: 512
    filter: CONFIG_ZTEST
    extra_configs:
      - CONFIG_AKIRA_CCSDS_RND=y
      - CONFIG_AKIRA_CCSDS_TM_RND=y
```
